## tools/driver/drivers/accel/Kconfig
```kconfig
#
# HW Accelerator device configuration
#

config HW_ACCEL
	tristate "Google HW Accelerator Class Support"
	help
	  HW Accelerator class support for Google. This option selects
	  the framework / common code needed for the Google's hardware
	  accelerator projects.
```

## tools/driver/drivers/asic_sw/Kconfig
```kconfig
config ASIC_SW
  tristate "ASIC-SW"
  depends on GASKET_FRAMEWORK
  help
  A common library used by asic_sw developed kernel drivers.

  To compile this driver as a module, choose M here.  The module
  will be called asic_sw.
```

## tools/driver/drivers/char/tpu_common/Kconfig
```kconfig
menu "tpu_common devices"

config TPU_COMMON_COMMON
 tristate "tpu_common Common library"
 help
 This common library provides functionality common to tpu_common
 devices.

 To compile this library as a module, choose M here.  The module
 will be called tpu_common_common.

config TPU_V2_CORE
  tristate "tpu_v2 Core Library"
  depends on GASKET_FRAMEWORK
  depends on TPU_COMMON_COMMON
  help
  This module provides functionality common to tpu_v2 class
  devices.

  To compile this driver as a module, choose M here.  The module
  will be called tpu_v2_core.

config TPU_V2_DRIVER
  tristate "tpu_v2 Driver"
  depends on TPU_V2_CORE
  help
  This driver supports the tpu_v2 device.  Say Y if you want to
  include this driver in the kernel.

  To compile this driver as a module, choose M here.  The module
  will be called tpu_v2.

config TPU_V3_DRIVER
  tristate "tpu_v3 Driver"
  depends on TPU_V2_CORE
  help
  This driver supports the tpu_v3 device.  Say Y if you want to
  include this driver in the kernel.

  To compile this driver as a module, choose M here.  The module
  will be called tpu_v3.

config TPU_V4_COMMON_COMMON
 tristate "TPU_V4_COMMON Common library"
 depends on ASIC_SW
 help
 This common library provides functionality common to tpuv4common
 devices.

 To compile this library as a module, choose M here.  The module
 will be called tpuv4common_common.

config TPU_V4_DRIVER
  tristate "tpu_v4 Driver"
  depends on GASKET_FRAMEWORK
  depends on TPU_COMMON_COMMON
  depends on TPU_V4_COMMON_COMMON
  help
  This driver supports the tpu_v4 device.  Say Y if you want to
  include this driver in the kernel.

  To compile this driver as a module, choose M here.  The module
  will be called tpu_v4.

config TPU_V4_LITE_DRIVER
  tristate "tpu_v4_lite Driver"
  depends on GASKET_FRAMEWORK
  depends on TPU_COMMON_COMMON
  depends on TPU_V4_COMMON_COMMON
  help
  This driver supports the tpu_v4_lite device.  Say Y if you want to
  include this driver in the kernel.

  To compile this driver as a module, choose M here.  The module
  will be called tpu_v4_lite.
endmenu
```

## tools/driver/drivers/gasket/Kconfig
```kconfig
config GASKET_FRAMEWORK
  select DMA_SHARED_BUFFER
  tristate "Gasket framework"
  depends on PCI
  depends on HW_ACCEL
  help
  This is a framework for lightweight kernel drivers, providing simplified
  support for MSI-x interrupts, two-level page tables, sysfs nodes, on
  character devices over PCI.

  To compile this driver as a module, choose M here.  The module
  will be called gasket.
```
